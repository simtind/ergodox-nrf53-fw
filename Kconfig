## boards/arm/blaatind/Kconfig.board
```kconfig
# Copyright (c) 2022 Nordic Semiconductor ASA
# SPDX-License-Identifier: Apache-2.0

config BOARD_BLAATIND_CPUAPP
	bool "blaatind_cpuapp"
	depends on SOC_NRF5340_CPUAPP_QKAA

config BOARD_BLAATIND_CPUNET
	bool "blaatind_cpunet"
	depends on SOC_NRF5340_CPUNET_QKAA
```

## boards/arm/blaatind/Kconfig.defconfig
```kconfig
# Copyright (c) 2022 Nordic Semiconductor ASA
# SPDX-License-Identifier: Apache-2.0

if BOARD_BLAATIND_CPUAPP

	config BOARD
		default "blaatind_cpuapp"
endif

if BOARD_BLAATIND_CPUNET

	config BOARD
		default "blaatind_cpunet"

endif


config ENTROPY_BT_HCI
	default y if BT_HCI_HOST
	depends on ENTROPY_GENERATOR
    
config IPM_NRFX
	default IPM

config MBOX_NRFX_IPC
	default MBOX

config RPMSG_SERVICE_DUAL_IPM_SUPPORT
	default RPMSG_SERVICE

if RPMSG_SERVICE_DUAL_IPM_SUPPORT

	config IPM_MSG_CH_0_ENABLE
		default y

	config IPM_MSG_CH_1_ENABLE
		default y

	config RPMSG_SERVICE_IPM_TX_NAME
		default "IPM_0" if RPMSG_SERVICE_MODE_MASTER
		default "IPM_1" if RPMSG_SERVICE_MODE_REMOTE

	config RPMSG_SERVICE_IPM_RX_NAME
		default "IPM_1" if RPMSG_SERVICE_MODE_MASTER
		default "IPM_0" if RPMSG_SERVICE_MODE_REMOTE

	config IPM_MSG_CH_0_TX
		default RPMSG_SERVICE_MODE_MASTER

	config IPM_MSG_CH_0_RX
		default RPMSG_SERVICE_MODE_REMOTE

	config IPM_MSG_CH_1_TX
		default RPMSG_SERVICE_MODE_REMOTE

	config IPM_MSG_CH_1_RX
		default RPMSG_SERVICE_MODE_MASTER

endif # RPMSG_SERVICE_DUAL_IPM_SUPPORT


if BOARD_BLAATIND_CPUAPP
		
	choice BT_HCI_BUS_TYPE
		default BT_RPMSG if BT
	endchoice

	config HEAP_MEM_POOL_SIZE
		default 4096 if BT_RPMSG

	config BT_HCI_VS
		default y if BT

endif

if BOARD_BLAATIND_CPUNET

	# BT_CTLR depends on BT. When BT is enabled we should default to also
	# enabling the controller.
	config BT_CTLR
		default y if BT

	config BT_ECC
		default y if BT

endif
```

## boards/arm/blaatind/blaatind_cpunet_defconfig
```kconfig
# Copyright (c) 2022 Nordic Semiconductor ASA
# SPDX-License-Identifier: Apache-2.0

CONFIG_SOC_SERIES_NRF53X=y
CONFIG_SOC_NRF5340_CPUNET_QKAA=y
CONFIG_BOARD_BLAATIND_CPUNET=y

# Enable MPU
CONFIG_ARM_MPU=y

# Enable hardware stack protection
CONFIG_HW_STACK_PROTECTION=y

# Enable MPU
CONFIG_ARM_MPU=y

# Enable hardware stack protection
CONFIG_HW_STACK_PROTECTION=y
```

## boards/arm/blaatind_cpunet/blaatind_cpunet_defconfig
```kconfig
# Copyright (c) 2022 Nordic Semiconductor ASA
# SPDX-License-Identifier: Apache-2.0

CONFIG_SOC_SERIES_NRF53X=y
CONFIG_SOC_NRF5340_CPUNET_QKAA=y
CONFIG_BOARD_BLAATIND_CPUNET=y

# Enable MPU
CONFIG_ARM_MPU=y

# Enable hardware stack protection
CONFIG_HW_STACK_PROTECTION=y

# IPM
# HCI_RPMSG
CONFIG_RPMSG_SERVICE=y
CONFIG_RPMSG_SERVICE_MODE_REMOTE=y

CONFIG_HEAP_MEM_POOL_SIZE=8192

CONFIG_BT=y
```

## boards/arm/tinderboard/Kconfig.board
```kconfig
# Copyright (c) 2022 Nordic Semiconductor ASA
# SPDX-License-Identifier: Apache-2.0

config BOARD_TINDERBOARD
	bool "tinderboard"
	depends on SOC_NRF5340_CPUAPP_QKAA

config BOARD_TINDERBOARD_CPUNET
	bool "tinderboard_cpunet"
	depends on SOC_NRF5340_CPUNET_QKAA
```

## boards/arm/tinderboard/Kconfig.defconfig
```kconfig
# Copyright (c) 2022 Nordic Semiconductor ASA
# SPDX-License-Identifier: Apache-2.0

if BOARD_TINDERBOARD

	config BOARD
		default "tinderboard"
		
	choice BT_HCI_BUS_TYPE
		default BT_RPMSG if BT
	endchoice

	config HEAP_MEM_POOL_SIZE
		default 4096 if BT_RPMSG

	config BT_HCI_VS
		default y if BT

endif

if BOARD_TINDERBOARD_CPUNET

	config BOARD
		default "tinderboard_cpunet"

	# BT_CTLR depends on BT. When BT is enabled we should default to also
	# enabling the controller.
	config BT_CTLR
		default y if BT

	config BT_ECC
		default y if BT

endif


config IPM_NRFX
	default IPM

config MBOX_NRFX_IPC
	default MBOX

config RPMSG_SERVICE_DUAL_IPM_SUPPORT
	default RPMSG_SERVICE

if RPMSG_SERVICE_DUAL_IPM_SUPPORT

	config IPM_MSG_CH_0_ENABLE
		default y

	config IPM_MSG_CH_1_ENABLE
		default y

	config RPMSG_SERVICE_IPM_TX_NAME
		default "IPM_0" if RPMSG_SERVICE_MODE_MASTER
		default "IPM_1" if RPMSG_SERVICE_MODE_REMOTE

	config RPMSG_SERVICE_IPM_RX_NAME
		default "IPM_1" if RPMSG_SERVICE_MODE_MASTER
		default "IPM_0" if RPMSG_SERVICE_MODE_REMOTE

	config IPM_MSG_CH_0_TX
		default RPMSG_SERVICE_MODE_MASTER

	config IPM_MSG_CH_0_RX
		default RPMSG_SERVICE_MODE_REMOTE

	config IPM_MSG_CH_1_TX
		default RPMSG_SERVICE_MODE_REMOTE

	config IPM_MSG_CH_1_RX
		default RPMSG_SERVICE_MODE_MASTER

endif # RPMSG_SERVICE_DUAL_IPM_SUPPORT
```

## boards/shields/blaatind/Kconfig.defconfig
```kconfig
# Copyright (c) 2020 The ZMK Contributors
# SPDX-License-Identifier: MIT

# Default stubs for properties originating in ZMK.
if !ZMK
    config ZMK_KEYBOARD_NAME
        string

    config ZMK_SPLIT_BLE_ROLE_CENTRAL
        bool
    config ZMK_SPLIT
        bool

    if !LVGL
        config ZMK_DISPLAY_SIZE
            int

        config ZMK_DISPLAY_VDB_SIZE
            int

        config LV_DPI_DEF
            int
    endif 
endif 

if SHIELD_BLAATIND_LEFT

    config ZMK_KEYBOARD_NAME
        default "Blaatind"

    config ZMK_SPLIT_BLE_ROLE_CENTRAL
        default y

    endif

if SHIELD_BLAATIND_LEFT || SHIELD_BLAATIND_RIGHT

    config ZMK_SPLIT
        default y
    
    if ZMK_DISPLAY

        config I2C
            default y

        config SSD1306
            default y

        config SSD1306_REVERSE_MODE
            default y

    endif # ZMK_DISPLAY

    if LVGL

        config ZMK_DISPLAY_SIZE
            default 4096

        config ZMK_DISPLAY_VDB_SIZE
            default 64

        config LV_DPI_DEF
            default 148

        choice LV_COLOR_DEPTH
            default LV_COLOR_DEPTH_1
        endchoice

    endif # LVGL
endif
```

## boards/shields/blaatind/Kconfig.shield
```kconfig
# Copyright (c) 2020 The ZMK Contributors
# SPDX-License-Identifier: MIT

config SHIELD_BLAATIND_LEFT
	def_bool $(shields_list_contains,blaatind_left)

config SHIELD_BLAATIND_RIGHT
	def_bool $(shields_list_contains,blaatind_right)
```

## config/west.yml
```yaml
manifest:
  remotes:
    - name: zmkfirmware
      url-base: https://github.com/zmkfirmware
    - name: simtind
      url-base: https://github.com/simtind
    - name: ncs
      url-base: https://github.com/nrfconnect
  projects:
    # - name: zephyr
    #   repo-path: sdk-zephyr
    #   remote: simtind
    #   revision: simtind/ncs+zmk-fixes
    #   clone-depth: 1
    #   import:
    #     # TODO: Rename once upstream offers option like `exclude` or `denylist`
    #     name-blocklist:
    #       - ci-tools
    #       - hal_altera
    #       - hal_cypress
    #       - hal_infineon
    #       - hal_microchip
    #       - hal_nxp
    #       - hal_openisa
    #       - hal_silabs
    #       - hal_xtensa
    #       - hal_st
    #       - hal_ti
    #       - loramac-node
    #       - net-tools
    #       - edtt
    #       - trusted-firmware-m
    #       - sof
    #       - mcuboot
    - name: nrf
      repo-path: sdk-nrf
      remote: ncs
      revision: main
      import: true
    - name: zmk
      remote: simtind
      revision: simtind/blaatind-fixes
      import: app/west.yml
  self:
    path: zmk/app
```

## config_net/west.yml
```yaml
manifest:
  remotes:
    - name: ncs
      url-base: https://github.com/nrfconnect
  projects:
    - name: nrf
      repo-path: sdk-nrf
      remote: ncs
      revision: main
      import: true
```

## west.yml
```yaml
manifest:
  remotes:
    - name: zmkfirmware
      url-base: https://github.com/zmkfirmware
    - name: simtind
      url-base: https://github.com/simtind
    - name: ncs
      url-base: https://github.com/nrfconnect
  projects:
    - name: nrf
      repo-path: sdk-nrf
      remote: simtind
      revision: main
      import: true
    - name: zmk
      remote: simtind
      revision: simtind/zephyr-update
      import:
        file: app/west.yml
        name-blocklist:
          zephyr
```
